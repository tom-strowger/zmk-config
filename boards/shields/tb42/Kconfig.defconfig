## boards/shields/tb42/Kconfig.defconfig
```kconfig
# Copyright (c) 2022 The ZMK Contributors
# SPDX-License-Identifier: MIT

if SHIELD_TB42_LEFT

config ZMK_KEYBOARD_NAME
    default "Tom's board 3x6"
    
config ZMK_SPLIT_ROLE_CENTRAL
    default y

endif

if SHIELD_TB42_LEFT || SHIELD_TB42_RIGHT

config ZMK_SPLIT
    default y

endif
```

## boards/shields/tb42/Kconfig.shield
```kconfig
# Copyright (c) 2022 The ZMK Contributors
# SPDX-License-Identifier: MIT

config SHIELD_TB42_LEFT
    def_bool $(shields_list_contains,tb42_left)

config SHIELD_TB42_RIGHT
    def_bool $(shields_list_contains,tb42_right)
```
