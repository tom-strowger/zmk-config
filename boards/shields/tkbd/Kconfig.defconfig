## boards/shields/tkbd/Kconfig.defconfig
```kconfig
# Copyright (c) 2022 The ZMK Contributors
# SPDX-License-Identifier: MIT

if SHIELD_TKBD_LEFT

config ZMK_KEYBOARD_NAME
    default "Tom's board"
    
config ZMK_SPLIT_ROLE_CENTRAL
    default y

endif

if SHIELD_TKBD_LEFT || SHIELD_TKBD_RIGHT

config ZMK_SPLIT
    default y

endif
```

## boards/shields/tkbd/Kconfig.shield
```kconfig
# Copyright (c) 2022 The ZMK Contributors
# SPDX-License-Identifier: MIT

config SHIELD_TKBD_LEFT
    def_bool $(shields_list_contains,tkbd_left)

config SHIELD_TKBD_RIGHT
    def_bool $(shields_list_contains,tkbd_right)
```
